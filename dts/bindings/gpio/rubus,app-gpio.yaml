## dts/bindings/gpio/rubus,app-gpio.yaml
```yaml
# Copyright (c) 2025 Rubus Technologies Inc.
# SPDX-License-Identifier: Apache-2.0

description: Simple GPIO output for application use

compatible: "rubus,app-gpio"

properties:
  gpios:
    type: phandle-array
    required: true
    description: GPIO pin specification
```

## dts/bindings/pwm/st,stm32-mcpwm.yaml
```yaml
description: STM32 Multi-Channel PWM

compatible: "st,stm32-mcpwm"

include: [pwm-controller.yaml, base.yaml, pinctrl-device.yaml]

properties:
  pinctrl-0:
    description: |
      Optional pin control configuration for PWM outputs.
      Required only when using PWM outputs. Can be omitted for timer-only mode
      (e.g., for timer synchronization, trigger generation, or timing without PWM outputs).

  pinctrl-names:
    description: |
      Optional pin control state names.
      Required only when pinctrl-0 is specified for PWM outputs.

  period:
    type: int
    required: true
    description: |
      PWM period in nanoseconds. This sets the frequency for ALL PWM channels
      on this timer. All channels share the same period/frequency.
      
      Use the standard PWM period helpers for convenience:
      - PWM_HZ(1000) for 1kHz
      - PWM_KHZ(20) for 20kHz  
      - PWM_USEC(50) for 50µs period
      - PWM_NSEC(25000) for 25µs period

  st,break-enable:
    type: boolean
    description: |
      Enable the break feature.
      This feature is used to stop the timer when a fault occurs.
      The fault can be generated by an external event or by the software.
      The timer can be restarted by the software or by an external event.

  st,break-polarity:
    type: string
    enum:
      - "low"
      - "high"
    default: "low"
    description: |
      Select the break polarity for the timer.
      This is used to stop the timer when a fault occurs.
      The value is a bitmask of the break polarities
      defined in the STM32 reference manual.

  st,break2-enable:
    type: boolean
    description: |
      Enable the break2 feature.
      This feature is used to stop the timer when a fault occurs.
      The fault can be generated by an external event or by the software.
      The timer can be restarted by the software or by an external event.

  st,break2-polarity:
    type: string
    enum:
      - "low"
      - "high"
    default: "low"
    description: |
      Select the break2 polarity for the timer.
      This is used to stop the timer when a fault occurs.
      The value is a bitmask of the break2 polarities
      defined in the STM32 reference manual.

  st,dead-time:
    type: int
    default: 0
    description: |
      Set the dead time value for the timer.

  st,cc-dma-channels:
    type: array
    description: |
      Optional list of 1-based compare channels that should assert DMA requests
      when the corresponding PWM output is enabled. Channels not listed keep
      their DMA request masked. This allows firmware to arm DMA only for the
      flows that require it while leaving other channels serviced by interrupts.

  st,ossr:
    type: boolean
    description: |
      Off-State Selection for Run mode.
      When enabled, the timer outputs are forced to their inactive level
      when the MOE bit is reset (run mode).

  st,ossi:
    type: boolean
    description: |
      Off-State Selection for Idle mode.
      When enabled, the timer outputs are forced to their inactive level
      when the MOE bit is reset (idle mode).

  st,lock-level:
    type: int
    enum: [0, 1, 2, 3]
    description: |
      Lock level for the timer configuration.
      0: LOCK OFF - No bit is write protected
      1: LOCK Level 1 - DTG bits in TIMx_BDTR register, OISx and OISxN bits in TIMx_CR2 register and BKE/BKP/AOE/DTG[7:0] in TIMx_BDTR register can no longer be written
      2: LOCK Level 2 - LOCK Level 1 + CC Polarity bits (CCxP/CCxNP bits in TIMx_CCER register) can no longer be written
      3: LOCK Level 3 - LOCK Level 2 + CC Control bits (OCxM and OCxPE bits in TIMx_CCMRx registers) can no longer be written

  st,automatic-output:
    type: boolean
    description: |
      Enable automatic output (AOE - Automatic Output Enable).
      When enabled, the MOE bit is automatically set by a hardware event (update event).
      This allows the timer outputs to be automatically re-enabled after a break event.
      When disabled, the MOE bit can only be set by software.

  "#pwm-cells":
    const: 2
    description: |
      Number of items to expect in a PWM
      - channel of the timer used for PWM
      - flags : combination of standard flags like PWM_POLARITY_NORMAL
        or specific flags like STM32_PWM_COMPLEMENTARY. As an example,
        the following complementary PWMs(CH2&CH2N) are shown below.
          <&pwm1 2 (PWM_POLARITY_NORMAL)>;
          <&pwm1 2 (PWM_POLARITY_NORMAL | STM32_PWM_COMPLEMENTARY)>;

pwm-cells:
  - channel
  - flags
```

## dts/bindings/rubus,angle-observer.yaml
```yaml
# Copyright (c) 2024 Rubus Inc.
# SPDX-License-Identifier: Apache-2.0

description: Angle observer configuration

compatible: "rubus,angle-observer"

properties:
  bandwidth-hz:
    type: int
    required: true
    description: Observer bandwidth in Hz (position tracking)
```

## dts/bindings/rubus,current-sense.yaml
```yaml
# Copyright (c) 2024 Rubus Inc.
# SPDX-License-Identifier: Apache-2.0

description: Current sensing configuration

compatible: "rubus,current-sense"

properties:
  channels:
    type: array
    required: true
    description: |
      ADC channel configurations as <channel polarity> tuples.
      Polarity: CURRENT_SENSE_POSITIVE (1) or CURRENT_SENSE_NEGATIVE (-1).

  adc-buffer-indices:
    type: array
    required: true
    description: |
      Indices into the ADC results buffer where each channel's data is stored.
      Must match the order of channels property (index 0 for first channel, etc.).

  current-sense-resistor-uohms:
    type: int
    required: true
    description: Current sense resistor in microohms

  current-sense-gain:
    type: int
    required: true
    description: Current sense amplifier gain

  vref-mv:
    type: int
    required: true
    description: ADC reference voltage in millivolts
```

## dts/bindings/rubus,fault-detection.yaml
```yaml
# Copyright (c) 2025 Rubus Technologies Inc
# SPDX-License-Identifier: Apache-2.0

description: Motor fault detection parameters

compatible: "rubus,fault-detection"

properties:
  encoder-fault-threshold:
    type: int
    required: true
    description: |
      Number of consecutive encoder read failures before triggering encoder fault.
      Higher values reduce false positives from occasional SPI glitches.
      At 20kHz control loop: 100 = 5ms, 200 = 10ms.

  overcurrent-threshold-ma:
    type: int
    required: true
    description: |
      Overcurrent detection threshold in milliamps.
      Typically set to 120-150% of motor max current rating.
      Must account for transient current spikes during acceleration.
```

## dts/bindings/rubus,vbus-sense.yaml
```yaml
# Copyright (c) 2024 Rubus Inc.
# SPDX-License-Identifier: Apache-2.0

description: DC bus voltage sensing configuration

compatible: "rubus,vbus-sense"

properties:
  channel:
    type: int
    required: true
    description: ADC channel number

  vref-mv:
    type: int
    required: true
    description: ADC reference voltage in millivolts

  output-ohms:
    type: int
    required: true
    description: Resistance from Vbus to ADC input in ohms

  full-ohms:
    type: int
    required: true
    description: Total resistance from Vbus to ground in ohms
```

## dts/bindings/rubus,voltage-sense.yaml
```yaml
# Copyright (c) 2024 Rubus Inc.
# SPDX-License-Identifier: Apache-2.0

description: DC bus voltage sensing configuration

compatible: "rubus,voltage-sense"

properties:
  channel:
    type: int
    required: true
    description: ADC channel number

  adc-buffer-index:
    type: int
    required: true
    description: Index into the ADC results buffer where this channel's data is stored

  vref-mv:
    type: int
    required: true
    description: ADC reference voltage in millivolts

  output-ohms:
    type: int
    required: true
    description: Resistance from Vbus to ADC input in ohms

  full-ohms:
    type: int
    required: true
    description: Total resistance from Vbus to ground in ohms
```

## dts/bindings/sensor/magntek,mt6835.yaml
```yaml
# Copyright (c) 2025 Rubus Technologies Inc.
# SPDX-License-Identifier: Apache-2.0

description: |
    MagnTek MT6835 Magnetic Encoder

compatible: "magntek,mt6835"

include: [sensor-device.yaml, spi-device.yaml]

properties:
  cal-en-gpios:
    type: phandle-array
    required: true
    description: |
      The CAL_EN signal is used to enable the calibration mode.
      When asserted, the MT6835 enters calibration mode.
```

## dts/bindings/spi _old/rubus,stm32-spi.yaml
```yaml
# Copyright (c) 2025 Rubus Technologies Inc.
# SPDX-License-Identifier: Apache-2.0

description: STM32 SPI controller using RTIO

compatible: "rubus,stm32-spi"

include: st,stm32-spi-common.yaml
```

## dts/bindings/spi _old/st,stm32-spi-tt.yaml
```yaml
# Copyright (c) 2025 Rubus Technologies Inc.
# SPDX-License-Identifier: Apache-2.0

description: STM32 SPI controller using timer-triggered DMA

compatible: "st,stm32-spi-tt"

include: st,stm32-spi-common.yaml
```

## dts/bindings/ti,drv8328.yaml
```yaml
# Copyright (c) 2025 Rubus Technologies Inc.
# SPDX-License-Identifier: Apache-2.0

description: |
  TI DRV8328 3-phase gate driver
  
  Supports 1-3 phase operation in two modes:
  - 3x mode: 3 half-bridges using GPIO for INL control
  - 6x mode: 6 independent switches using complementary PWM for INL control

compatible: "ti,drv8328"

include: base.yaml

properties:
  pwms:
    type: phandle-array
    required: true
    description: |
      MCPWM channels for INHx (high-side control) signals.
      One PWM channel per half-bridge (1-3 channels supported).
      Number of entries determines the channel count.
      Format: <&mcpwm_device channel flags>

  inl-gpios:
    type: phandle-array
    description: |
      GPIO pins for INLx (low-side enable) signals.
      One GPIO per half-bridge. Only used in 3x mode.
      These will be set high when channel is enabled, low when disabled.

  mode:
    type: string
    required: true
    enum:
      - "3x"
      - "6x"
    description: |
      Operating mode:
      - "3x": 3 half-bridges with GPIO control for INL (independent timers allowed)
      - "6x": 6 independent switches with complementary PWM for INL (requires single timer)

  sleep-gpios:
    type: phandle-array
    description: |
      nSLEEP control pin (active high).
      When low, device enters sleep mode.
      Used for fault reset via low pulse.

  fault-gpios:
    type: phandle-array
    description: |
      nFAULT status pin (active low).
      Triggers interrupt on fault conditions.

  drvoff-gpios:
    type: phandle-array
    description: |
      DRVOFF gate driver disable pin (active high, DRV8328C/D variants only).
      When high, disables all gate drivers independent of PWM state.
```

## dts/bindings/timer/rubus,stm32-timers.yaml
```yaml
# Copyright (c) 2025 Rubus Technologies Inc.
# SPDX-License-Identifier: Apache-2.0

description: STM32 timers

compatible: "rubus,stm32-timers"

include: st,stm32-timers.yaml

properties:
  st,master-mode:
    type: boolean
    description: |
      Enable the master mode controller.
      This mode is used to generate a trigger signal for slave timers
      or to synchronize with other timers.

  st,slave-mode:
    type: boolean
    description: |
      Enable the slave mode controller.
      This mode is used to synchronize the timer with another timer

  st,trigger-selection:
    type: int
    description: |
      Select the trigger source for the timer.
      This is used to synchronize the timer with another timer
      or external event. The value is a bitmask of the trigger sources
      defined in the STM32 reference manual.

  st,trigger-polarity:
    type: int
    description: |
      Select the trigger polarity for the timer.
      This is used to synchronize the timer with another timer
      or external event. The value is a bitmask of the trigger polarities
      defined in the STM32 reference manual.

  st,master-mode-selection:
    type: int
    description: |
      These bits allow to select the information to be sent in master mode
      to slave timers for synchronization (TRGO).

  st,slave-mode-selection:
    type: int
    description: |
      When external signals are selected the active edge of the trigger
      signal (TRGI) is linked to the polarity selected on the external input
      (see Input Control register and Control register description).

  st,one-pulse-mode:
    type: boolean
    description: |
      Enable the one pulse mode controller.
      This mode is used to generate a single pulse on the output
      when the timer is triggered.

  st,repetition-counter:
    type: int
    default: 0
    description: |
      Set the repetition counter value for the timer.
      This is only available on advanced timers (TIM1, TIM8, TIM15, TIM16, TIM17, TIM20).
      The repetition counter allows the timer to generate update events only after
      a specified number of counting cycles, providing advanced PWM control.
      Valid range is 0-255.
```

## west.yml
```yaml
# Copyright (c) 2023 Rubus Technologies Inc.
# SPDX-License-Identifier: Apache-2.0

manifest:
  self:
    west-commands: scripts/west-commands.yml

  remotes:
    - name: zephyrproject-rtos
      url-base: https://github.com/zephyrproject-rtos
    - name: dgamroth-github
      url-base: https://github.com/DarrylGamroth

  projects:
    # - name: vscode-settings-zephyr
    #   remote: dgamroth-github
    #   revision: main
    #   import: true
    - name: zephyr
      remote: zephyrproject-rtos
      revision: main
      import:
        # Please keep this list sorted alphabetically.
        name-whitelist:
          # - cmsis
          - cmsis_6
          - cmsis-dsp
            #- fatfs
          - hal_stm32
          - littlefs
          - mbedtls
          - mcuboot
          - mcumgr
          - picolibc
          - segger
```
