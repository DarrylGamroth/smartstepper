/*
 * Safe identification defaults for a 50 pole-pair hybrid stepper in the
 * 1.5-2.0 A class on a 24 V bus.
 *
 * This overlay intentionally contains only motor/control/fault defaults. Pair
 * it with an encoder overlay such as encoder_mt6835_rtspi.overlay. Values here
 * should be conservative enough to bring up the PI current controller, run
 * current offsets, bidirectional Rs, R/L bootstrap, and demodulated Ld/Lq
 * identification before commissioned settings are saved.
 */

/ {
	user_parameters: user_parameters {
		compatible = "rubus,user-parameters";
		nominal_voltage-mv = <24000>;
		pwm-frequency-hz = <20000>;
		control-loop-frequency-hz = <20000>;
		current-loop-bandwidth-hz = <150>;
		current-command-ramp-ms = <100>;
		offset-pole-hz = <300>;
		encoder-direction-sign = <(-1)>;
		align-current-ma = <200>;
		align-duration-ms = <100>;
		brake-current-ma = <1500>;
		max-modulation-index-mpu = <950>;

		roverl-est-current-ma = <300>;
		roverl-est-freq-hz = <250>;
		roverl-est-settling-ms = <50>;
		roverl-est-duration-ms = <5000>;

		commission-electrical-rs-current-ma = <300>;
		commission-electrical-current-limit-ma = <300>;
		commission-electrical-demod-pulse-mv = <500>;
		commission-electrical-max-pulse-mv = <500>;

		rls-excitation-current-ma = <100>;
		velocity-max-hz = <5>;
		velocity-max-accel-hz-per-s = <20>;
		velocity-initial-hz = <0>;

		commission-standard-min-auto-iq-ma = <250>;
		commission-validate-current-default-iq-ma = <80>;
	};

	motor_parameters: motor_parameters {
		compatible = "rubus,motor-parameters";
		inductance-d-uh = <2903>;
		inductance-q-uh = <2903>;
		resistance-mohms = <2253>;
		flux_linkage_uvphz = <17675>;
		pole-pairs = <50>;
		max-current-ma = <1500>;
		inertia-mgcm2 = <57000>;
		max-speed-hz = <5>;
	};

	fault_detection: fault_detection {
		compatible = "rubus,fault-detection";
		encoder-fault-threshold = <100>;
		overcurrent-threshold-ma = <1800>;
	};
};
