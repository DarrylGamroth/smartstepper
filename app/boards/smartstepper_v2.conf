## app/boards/smartstepper_v2.conf
```kconfig
# Copyright (c) 2025 Rubus Technologies Inc
# SPDX-License-Identifier: Apache-2.0
#
# This file contains selected Kconfig options for the application.


CONFIG_ETH_DRIVER=y
CONFIG_NETWORKING=y
CONFIG_NET_L2_ETHERNET=y

CONFIG_NET_IPV6=n
CONFIG_NET_IPV4=y
CONFIG_NET_DHCPV4=y

CONFIG_NET_LOG=y
CONFIG_NET_SHELL=y
CONFIG_NET_CONFIG_SETTINGS=y

CONFIG_MDIO_SHELL=y

CONFIG_SRAM_VECTOR_TABLE=y
CONFIG_SRAM_SW_ISR_TABLE=y
```

## boards/rubus/simplechopper/Kconfig.board
```kconfig
# Simple Chopper MCU configuration

# Copyright (c) 2023 Rubus Technologies Inc.
# SPDX-License-Identifier: Apache-2.0

config BOARD_SIMPLECHOPPER
	bool "Simple Chopper Board"
	depends on SOC_STM32G071XX
```

## boards/rubus/simplechopper/Kconfig.defconfig
```kconfig
# Simple Chopper Board

# Copyright (c) 2023 Rubus Technologies Inc.
# SPDX-License-Identifier: Apache-2.0

if BOARD_SIMPLECHOPPER

config BOARD
	default "simplechopper"

endif # BOARD_SIMPLECHOPPER
```

## boards/rubus/smartchopper/Kconfig.smartchopper
```kconfig
# Copyright (c) 2025 Rubus Technologies Inc.
# SPDX-License-Identifier: Apache-2.0

config BOARD_SMARTCHOPPER
	select SOC_STM32F407XE
```

## boards/rubus/smartchopper/board.yml
```yaml
# Copyright (c) 2024 Nordic Semiconductor ASA
# SPDX-License-Identifier: Apache-2.0

board:
  name: smartchopper
  vendor: rubus
  socs:
    - name: STM32F407XE
```

## boards/rubus/smartchopper/smartchopper_defconfig
```kconfig
# Enable MPU
CONFIG_ARM_MPU=y
CONFIG_HW_STACK_PROTECTION=y

# GPIO Controller
CONFIG_GPIO=y

# Enables clocks
CONFIG_CLOCK_CONTROL=y

# enable pin controller
CONFIG_PINCTRL=y
```

## boards/rubus/smartstepper/Kconfig.defconfig
```kconfig
# Smart Stepper board configuration

# Copyright (c) 2025 Rubus Technologies Inc.
# SPDX-License-Identifier: Apache-2.0

if BOARD_SMARTSTEPPER

config SPI_STM32_INTERRUPT
	default y
	depends on SPI

endif # BOARD_SMARTSTEPPER
```

## boards/rubus/smartstepper_v2/Kconfig.defconfig
```kconfig
# Smart Stepper board configuration

# Copyright (c) 2025 Rubus Technologies Inc.
# SPDX-License-Identifier: Apache-2.0

if BOARD_SMARTSTEPPER_V2

config SPI_STM32_INTERRUPT
	default y
	depends on SPI

endif # BOARD_SMARTSTEPPER_V2
```

## boards/rubus/smartstepper_v2/Kconfig.smartstepper_v2
```kconfig
# Copyright (c) 2025 Rubus Technologies Inc.
# SPDX-License-Identifier: Apache-2.0

config BOARD_SMARTSTEPPER_V2
	select SOC_STM32H743XX
```

## boards/rubus/smartstepper_v2/board.yml
```yaml
# Copyright (c) 2025 Rubus Technologies Inc.
# SPDX-License-Identifier: Apache-2.0

board:
  name: smartstepper_v2
  vendor: rubus
  socs:
    - name: stm32h743xx
```

## boards/rubus/smartstepper_v2/smartstepper_v2_defconfig
```kconfig
# SPDX-License-Identifier: Apache-2.0

# enable GPIO
CONFIG_GPIO=y

# Enable MPU
CONFIG_ARM_MPU=y

# Enable HW stack protection
CONFIG_HW_STACK_PROTECTION=y

CONFIG_CODE_DATA_RELOCATION=y

# CONFIG_STM32_MEMMAP=y
```

## drivers/adc/Kconfig
```kconfig
# ADC configuration options

# Copyright (c) 2019 Intel Corporation
# Copyright (c) 2019 Endre Karlson
# Copyright (c) 2019 Song Qiang <songqiang1304521@gmail.com>
# Copyright (c) 2021 Marius Scholtz, RIC Electronics
# Copyright (c) 2022 Hein Wessels, Nobleo Technology
# Copyright (c) 2024 STMicroelectronics
# Copyright (c) 2025 Rubus Technologies Inc.
# SPDX-License-Identifier: Apache-2.0

config ADC_STM32_INJECTED
	bool "STM32 Injected ADC driver"
	default y
	depends on DT_HAS_ST_STM32_ADC_INJECTED_ENABLED
	select PINCTRL
	help
	  Enable the driver implementation for the stm32xx ADC

config ADC_STM32WB0
	bool "STM32WB0 ADC driver"
	default y
	depends on DT_HAS_ST_STM32WB0_ADC_ENABLED
	select PINCTRL
	help
	  Enable the driver implementation for the STM32WB0 series ADC
```

## drivers/gate_driver/Kconfig
```kconfig
# Copyright (c) 2025 Rubus Technologies Inc.
# SPDX-License-Identifier: Apache-2.0

menuconfig GATE_DRIVER
    bool "Gate Driver Support"
    help
      Enable config options for Gate Driver support.

if GATE_DRIVER
module = GATE_DRIVER
module-str = gate_driver
source "subsys/logging/Kconfig.template.log_config"

config GATE_DRIVER_INIT_PRIORITY
	int "Gate driver initialization priority"
	default 60
	help
	  System initialization priority for gate driver drivers.
	  Must be higher than PWM_INIT_PRIORITY since gate drivers depend on PWM.

rsource "Kconfig.drv8328"

endif # GATE_DRIVER
```

## drivers/gate_driver/Kconfig.drv8328
```kconfig
# Gate Drivers

# Copyright (c) 2025 Rubus Technologies Inc.
# SPDX-License-Identifier: Apache-2.0

config GATE_DRIVER_TI_DRV8328
	bool "TI DRV8328 Gate Driver"
	default y
	depends on DT_HAS_TI_DRV8328_ENABLED
	help
	  Enable driver for TI DRV8328 gate driver.
```

## drivers/pwm/Kconfig
```kconfig
# Copyright (c) 2025 Rubus Technologies Inc.
# SPDX-License-Identifier: Apache-2.0

# menuconfig PWM
# 	bool "Pulse Width Modulation (PWM) drivers"
# 	help
# 	  Enable config options for PWM drivers.

if PWM

# module = PWM
# module-str = pwm
# source "subsys/logging/Kconfig.template.log_config"

# config PWM_INIT_PRIORITY
# 	int "PWM initialization priority"
# 	default KERNEL_INIT_PRIORITY_DEVICE
# 	help
# 	  System initialization priority for PWM drivers.

rsource "Kconfig.stm32"


endif # PWM
```

## drivers/pwm/Kconfig.stm32
```kconfig
# STM32 PWM configuration options

# Copyright (c) 2016 Linaro Limited.
# Copyright (c) 2025 Rubus Technologies Inc.
# SPDX-License-Identifier: Apache-2.0

config PWM_STM32_MCPWM
	bool "STM32 MCU MC-PWM driver"
	default y
	depends on DT_HAS_ST_STM32_MCPWM_ENABLED
	select RESET
	select PINCTRL
	help
	  This option enables the PWM driver for STM32 family of
	  processors. Say y if you wish to use PWM port on STM32
	  MCU.
```

## drivers/sensor/Kconfig
```kconfig
# Copyright (c) 2021 Nordic Semiconductor ASA
# SPDX-License-Identifier: Apache-2.0

if SENSOR
rsource "magntek_mt6835/Kconfig"
rsource "brcm_aeat-9955/Kconfig"
endif # SENSOR
```

## drivers/sensor/brcm_aeat-9955/Kconfig
```kconfig
# AEAT-9955 magnetic encoder configuration option

# Copyright (c) 2025 Rubus Technologies Inc.
# SPDX-License-Identifier: Apache-2.0

config BRCM_AEAT_9955
	bool "AEAT-9955 Magnetic Encoder"
	default y
	depends on DT_HAS_BRCM_AEAT_9955_ENABLED
	select SPI
	help
	  Enable driver for AEAT-9955 magnetic encoder.
```

## drivers/sensor/magntek_mt6835/Kconfig
```kconfig
# MT6835 magnetic encoder configuration option

# Copyright (c) 2025 Rubus Technologies Inc.
# SPDX-License-Identifier: Apache-2.0

config MAGNTEK_MT6835
	bool "MT6835 Magnetic Encoder"
	default y
	depends on DT_HAS_MAGNTEK_MT6835_ENABLED
	select SPI
	help
	  Enable driver for MT6835 magnetic encoder.
```

## drivers/spi_old/Kconfig.stm32
```kconfig
# STM32 SPI driver configuration options

# Copyright (c) 2015-2016 Intel Corporation
# Copyright (c) 2025 Rubus Technologies Inc.
# SPDX-License-Identifier: Apache-2.0

menuconfig SPI_RUBUS_STM32
	bool "STM32 MCU SPI controller driver"
	default y
	depends on DT_HAS_RUBUS_STM32_SPI_ENABLED
	select USE_STM32_LL_SPI
	select PINCTRL
	select SPI_RTIO
	help
	  Enable SPI support on the STM32 family of processors.

if SPI_RUBUS_STM32

config SPI_RUBUS_STM32_INTERRUPT
	bool "STM32 MCU SPI Interrupt Support"
	default y
	help
	  Enable Interrupt support for the SPI Driver of STM32 family.

config SPI_RUBUS_STM32_DMA
	bool "STM32 MCU SPI DMA Support"
	select DMA
	select CACHE_MANAGEMENT if CPU_HAS_DCACHE
	help
	  Enable the SPI DMA mode for SPI instances
	  that enable dma channels in their device tree node.

config SPI_RUBUS_STM32_DMA_MIN_LEN
	int "Minimum transfer length to use DMA"
	default 64
	depends on SPI_RUBUS_STM32_DMA
	help
	  Minimum number of bytes in a transfer to use DMA instead of
	  interrupt or polling mode. DMA has overhead for setup, so very
	  small transfers are more efficient with interrupt/polling modes.
	  This value should be tuned based on your application's typical
	  transfer sizes and performance requirements.

config SPI_RUBUS_STM32_USE_HW_SS
	bool "STM32 Hardware Slave Select support"
	default n
	help
	  Use Slave Select pin instead of software Slave Select.

config SPI_RUBUS_STM32_ERRATA_BUSY
	bool
	default y
	depends on SOC_SERIES_STM32F7X || SOC_SERIES_STM32L4X
	help
	  Handles erratum "BSY bit may stay high at the end of a data
	  transfer in slave mode".
	  Seen for instance in Errata Sheet 0290 §2.11.2

if SPI_RUBUS_STM32_ERRATA_BUSY

config SPI_RUBUS_STM32_BUSY_FLAG_TIMEOUT
	int "timeout in us for the STM32 busy flag workaround"
	default 10000

endif # SPI_RUBUS_STM32_ERRATA_BUSY

config SPI_RUBUS_STM32_RTIO_SQ_SIZE
	int "Number of available submission queue entries"
	default 8 # Sensible default that covers most common spi transactions
	help
	  When RTIO is used with SPI, each driver holds a context whose blocking API
	  calls is used to perform SPI transactions. This queue needs to be as deep
	  as the longest set of spi_buf_sets used, where normal SPI operations are
	  used (equal length buffers). It may need to be slightly deeper where the
	  spi buffer sets for transmit/receive are not always matched equally in
	  length as these are transformed into normal transceives.

config SPI_RUBUS_STM32_RTIO_CQ_SIZE
	int "Number of available completion queue entries"
	default 8 # Sensible default that covers most common spi transactions

endif # SPI_RUBUS_STM32
```

## drivers/spi_tt/Kconfig
```kconfig
# SPI driver configuration options

# Copyright (c) 2025 Rubus Technologies Inc.
# SPDX-License-Identifier: Apache-2.0

#
# SPI Drivers
#
# menuconfig SPI
# 	bool "Serial Peripheral Interface (SPI) bus drivers"
# 	help
# 	  Enable support for the SPI hardware bus.

if SPI

rsource "Kconfig.stm32"

endif
```

## drivers/timer_ic/Kconfig
```kconfig
# Copyright (c) 2023 Rubus Technologies Inc.
# SPDX-License-Identifier: Apache-2.0

menuconfig TIMER_IC
	bool "Timer Input Capture Drivers"
	help
	  Enable options for input capture drivers.

if TIMER_IC

module = TIMER_IC
module-str = timer_ic
source "subsys/logging/Kconfig.template.log_config"

config TIMER_IC_INIT_PRIORITY
	int "Timer input capture initialization priority"
	default KERNEL_INIT_PRIORITY_DEVICE
	help
	  System initialization priority for input capture drivers.

rsource "Kconfig.stm32"

endif # TIMER_IC
```

## drivers/timer_ic/Kconfig.stm32
```kconfig
# Copyright (c) 2023 Rubus Technologies Inc.
# SPDX-License-Identifier: Apache-2.0

config TIMER_IC_STM32
	bool "STM32 timer input capture driver"
	default y
	depends on DT_HAS_ST_STM32_TIMER_IC_ENABLED
	select USE_STM32_LL_TIM
	select USE_STM32_LL_RCC if SOC_SERIES_STM32F4X || SOC_SERIES_STM32F7X || SOC_SERIES_STM32H7X
	help
	  Enable timer input capture driver for STM32 SoCs
```

## dts/bindings/adc/st,stm32-adc-injected.yaml
```yaml
# Copyright (c) 2025 Rubus Technologies Inc.
# SPDX-License-Identifier: Apache-2.0

description: |
  STM32 ADC Injected Channel Driver
  
  This is a specialized driver for ultra low-latency motor control applications
  using hardware-triggered injected channel conversions. It is NOT compatible
  with the standard Zephyr ADC API.
  
  Inherits all base ADC properties from st,stm32-adc.yaml including clock
  configuration, pinctrl, resolution, etc.

compatible: "st,stm32-adc-injected"

include: st,stm32-adc.yaml

properties:
  resolution:
    type: int
    description: |
      ADC resolution in bits. Must match one of the resolutions available
      in the parent 'resolutions' property. For STM32H7, valid values are:
      16, 14, 12, 10, or 8 bits.
      If not specified, defaults to the first resolution in the resolutions array.

  st,adc-trigger-source:
    type: string
    required: true
    description: |
      External trigger source for injected channel conversions.
      Format: TIMx_CHy or TIMx_TRGO (uppercase, matches LL_ADC_INJ_TRIG_EXT_* defines).
      Valid values depend on the specific STM32 family. See STM32 LL driver headers
      (stm32xxxx_ll_adc.h) for available triggers on your MCU.
      
      Common examples:
        - TIM1_TRGO, TIM1_TRGO2, TIM1_CH4
        - TIM2_TRGO, TIM2_CH1
        - TIM3_TRGO, TIM3_CH1, TIM3_CH3, TIM3_CH4
        - TIM4_TRGO
        - TIM6_TRGO
        - TIM8_TRGO, TIM8_TRGO2, TIM8_CH4
        - TIM15_TRGO
  
  st,adc-trigger-edge:
    type: string
    default: "rising"
    description: |
      Edge sensitivity for external trigger.
    enum:
      - "rising"
      - "falling"
      - "both"
```

## dts/bindings/adc/st,stm32-injected-adc.yaml
```yaml
# Copyright (c) 2021, Teslabs Engineering S.L.
# SPDX-License-Identifier: Apache-2.0

description: STM32 Injected Channel ADC

compatible: "st,stm32-injected-adc"

include: st,stm32-adc.yaml

properties:
  adc-trigger:
    type: int
    required: true
    description: |
      External trigger for the injected ADC conversions. The external trigger
      must be an output of the timer used for SV-PWM.

      Definitions available at dts-bindings/adc/stm32fxxx.h files.
```
