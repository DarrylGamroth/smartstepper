## dts/bindings/rubus,user-parameters.yaml
```yaml
# Copyright (c) 2024 Rubus Inc.
# SPDX-License-Identifier: Apache-2.0

description: User-configurable motor control parameters

compatible: "rubus,user-parameters"

properties:
  nominal_voltage-mv:
    type: int
    required: true
    description: Nominal DC bus voltage in millivolts

  pwm-frequency-hz:
    type: int
    required: true
    description: PWM switching frequency in Hz

  control-loop-frequency-hz:
    type: int
    required: true
    description: Current control loop frequency in Hz

  current-loop-bandwidth-hz:
    type: int
    required: true
    description: Current controller bandwidth in Hz

  current-command-ramp-ms:
    type: int
    default: 100
    description: >
      Default Id/Iq command slew time in milliseconds. Runtime online current
      references ramp from zero to max-current over this interval unless a
      calibration state programs a more specific trajectory rate.

  offset-pole-hz:
    type: int
    required: true
    description: Current offset filter pole frequency in Hz

  align-current-ma:
    type: int
    required: true
    description: Rotor alignment current in milliamps

  align-duration-ms:
    type: int
    required: true
    description: Rotor alignment duration in milliseconds

  brake-current-ma:
    type: int
    required: true
    description: Braking current in milliamps

  max-modulation-index-mpu:
    type: int
    required: true
    description: Maximum modulation index in milli-per-unit (570 mpu = 0.57, typical max for SVPWM)

  roverl-est-current-ma:
    type: int
    required: true
    description: RoverL estimation current amplitude in milliamps (10-20% of rated)

  roverl-est-freq-hz:
    type: int
    required: true
    description: RoverL estimation frequency in Hz (default 100 Hz, increase if motor twitches)

  roverl-est-settling-ms:
    type: int
    required: true
    description: RoverL PI controller settling time before measurements in milliseconds (default 50 ms)

  roverl-est-duration-ms:
    type: int
    required: true
    description: RoverL estimation duration in milliseconds (default 5000 ms)

  rs-est-current-ma:
    type: int
    required: true
    description: Rs estimation DC current in milliamps (same as RoverL, 10-20% rated)

  rs-est-rampup-ms:
    type: int
    required: true
    description: Rs estimation ramp-up time in milliseconds (default 1000 ms)

  rs-est-duration-ms:
    type: int
    required: true
    description: Rs estimation measurement duration in milliseconds (default 6000 ms)

  rls-decimation:
    type: int
    default: 16
    description: RLS update rate decimation (power-of-2, default 16 = 1.25 kHz @ 20 kHz loop)

  rls-excitation-current-ma:
    type: int
    default: 100
    description: RLS PRBS excitation amplitude in milliamps applied to d-axis current reference

  prbs-amplitude-millivolts:
    type: int
    default: 100
    description: Legacy RLS PRBS amplitude property (interpreted as milliamps for compatibility)

  rls-lambda-mppu:
    type: int
    default: 9999
    description: RLS forgetting factor in milli-per-unit (9999 mppu = 0.9999)

  rls-convergence-threshold-mpu:
    type: int
    default: 100
    description: RLS convergence threshold for trace(P) in milli-per-unit (100 mpu = 0.1)

  rls-initial-covariance-mpu:
    type: int
    default: 1000
    description: RLS initial covariance diagonal in milli-per-unit (1000 mpu = 1.0)

  rls-initial-lq-millihenries:
    type: int
    default: 5000
    description: Initial Lq estimate in millihenries for cross-coupling (5000 mH = 5 mH)

  rls-stagger-offset:
    type: int
    default: 8
    description: Q-axis RLS stagger offset for load spreading (default 8 = half of decimation)

  thermal-decimation:
    type: int
    default: 2048
    description: Thermal model update rate decimation (default 2048 = ~10Hz @ 20kHz loop)

  thermal-resistance-c-per-w-milli:
    type: int
    default: 10000
    description: Thermal resistance in milli-°C/W (10000 = 10 °C/W typical for small motors)

  thermal-capacitance-j-per-c:
    type: int
    default: 50
    description: Thermal capacitance in J/°C (50 J/°C typical for small motors)

  thermal-ambient-temp-c:
    type: int
    default: 25
    description: Ambient temperature in °C

  rs-temp-coeff-ppm-per-c:
    type: int
    default: 3930
    description: Rs temperature coefficient in ppm/°C (3930 = 0.00393/°C for copper)

  rs-ref-temp-c:
    type: int
    default: 25
    description: Reference temperature for Rs measurement in °C

  rls-min-current-ma:
    type: int
    default: 100
    description: Minimum current magnitude for RLS observability in milliamps

  rls-min-speed-hz:
    type: int
    default: 1
    description: Minimum electrical speed for back-EMF observability in Hz

  rls-max-residual-volts:
    type: int
    default: 5
    description: Maximum RLS residual before disabling (divergence detection) in volts

  rls-max-voltage-volts:
    type: int
    default: 50
    description: Maximum voltage magnitude for validity check in volts

  velocity-max-hz:
    type: int
    default: 50
    description: Maximum mechanical velocity in Hz (revolutions per second)

  velocity-max-accel-hz-per-s:
    type: int
    default: 10
    description: Maximum velocity acceleration/deceleration rate in Hz/s

  velocity-initial-hz:
    type: int
    default: 0
    description: Initial velocity setpoint in Hz (typically 0)

  encoder-direction-sign:
    type: int
    default: 1
    enum:
      - 1
      - 4294967295
    description: >
      Mechanical encoder direction mapping sign used by the control loop.
      Set to 1 for normal direction, or -1 to invert measured mechanical
      angle/speed without writing encoder EEPROM. In devicetree overlays use
      `<(-1)>` for the inverted case.

  commission-standard-min-auto-iq-ma:
    type: int
    default: 250
    description: >
      Minimum Iq limit used by the one-command commissioning workflow before
      flux/mechanical identification. This prevents profile overlays with very
      conservative runtime velocity limits from starving the identification
      stage.

  commission-auto-velocity-bandwidth-mhz:
    type: int
    default: 20000
    description: >
      Temporary velocity PI bandwidth in milli-hertz used only during
      one-command commissioning flux/mechanical captures. This should be high
      enough that velocity commands track without large acceleration phase lag,
      but still below the point where the motor chatters or saturates.

  commission-validate-current-default-iq-ma:
    type: int
    default: 80
    description: >
      Default Iq used by `motor commission validate current` when no current is
      specified. This is a per-motor smoke-test value and should exceed static
      friction/detent torque without approaching the motor current limit.

  commission-electrical-rs-current-ma:
    type: int
    description: >
      Default current for production bidirectional resistance identification in
      milliamps. If omitted, firmware falls back to rs-est-current-ma.

  commission-electrical-current-limit-ma:
    type: int
    description: >
      Maximum current accepted by production electrical identification shell
      commands in milliamps. If omitted, firmware falls back to
      commission-electrical-rs-current-ma, then rs-est-current-ma.

  commission-electrical-samples:
    type: int
    default: 128
    description: Default accepted sample count for each production electrical ID axis.

  commission-electrical-min-samples:
    type: int
    default: 8
    description: Minimum accepted sample count for production electrical ID commands.

  commission-electrical-max-samples:
    type: int
    default: 512
    description: Maximum accepted sample count for production electrical ID commands.

  commission-electrical-settle-ms:
    type: int
    description: >
      Default settling time before production Rs capture in milliseconds. If
      omitted, firmware falls back to rs-est-duration-ms.

  commission-electrical-current-ramp-ms:
    type: int
    description: >
      Current ramp time used by production electrical ID in milliseconds. If
      omitted, firmware falls back to rs-est-rampup-ms.

  commission-electrical-l-pulse-mv:
    type: int
    default: 250
    description: Default direct-voltage pulse amplitude for integral inductance ID.

  commission-electrical-l-pulse-ms:
    type: int
    default: 5
    description: Default direct-voltage pulse width for integral inductance ID.

  commission-electrical-demod-pulse-mv:
    type: int
    description: >
      Default direct-voltage pulse amplitude for VESC-style inverse-L demod ID.
      If omitted, firmware falls back to commission-electrical-l-pulse-mv.

  commission-electrical-demod-pulse-ms:
    type: int
    default: 2
    description: >
      Default direct-voltage pulse width for VESC-style inverse-L demod ID.
      For a 20 kHz PWM loop, 2 ms is a practical shell-command approximation
      of VESC's faster PWM-rate HFI demod cadence.

  commission-electrical-demod-half-cycles:
    type: int
    default: 40
    description: >
      Default VESC-style inverse-L demod half-period in control-loop cycles.
      At 20 kHz, 40 cycles gives a 250 Hz positive/negative excitation cycle.

  commission-electrical-min-pulse-mv:
    type: int
    default: 20
    description: Minimum allowed direct-voltage pulse amplitude in millivolts.

  commission-electrical-max-pulse-mv:
    type: int
    default: 500
    description: Maximum allowed direct-voltage pulse amplitude in millivolts.

  commission-electrical-min-pulse-ms:
    type: int
    default: 1
    description: Minimum allowed direct-voltage pulse width in milliseconds.

  commission-electrical-sweep-max-spread-mpu:
    type: int
    default: 350
    description: Maximum qualified inductance sweep spread in milli-per-unit.

  commission-electrical-sweep-min-qualified-mv:
    type: int
    default: 200
    description: Minimum voltage pulse considered high-SNR for inductance sweep qualification.

  commission-electrical-demod-scale-mpu:
    type: int
    default: 900
    description: Scale factor applied to demodulated inductance in milli-per-unit.

  commission-electrical-demod-max-spread-mpu:
    type: int
    default: 200
    description: Maximum inverse-L demod spread ratio in milli-per-unit.

  commission-electrical-validate-ms:
    type: int
    default: 300
    description: Default hold time for electrical current-loop validation.

  commission-electrical-validate-error-ua:
    type: int
    default: 10000
    description: Default accepted average current-loop validation error in microamps.

  commission-auto-post-wait-ms:
    type: int
    default: 2500
    description: Timeout waiting for an auto-commission capture to finalize.

  commission-auto-mech-runs:
    type: int
    default: 3
    description: Number of accepted mechanical identification captures to aggregate.

  commission-auto-mech-max-attempts:
    type: int
    default: 5
    description: Maximum mechanical identification capture attempts.

  commission-auto-mech-cycles-per-capture:
    type: int
    default: 1
    description: Number of dither-pattern cycles per mechanical capture.

  commission-auto-mech-accel-margin-mpu:
    type: int
    default: 1250
    description: >
      Milli-per-unit margin used when deriving mechanical dither period from
      the configured acceleration limit.

  commission-auto-mech-validate-rms-unm:
    type: int
    default: 5000
    description: Mechanical validation residual RMS limit in micro-newton-meters.

  commission-auto-mech-validate-rms-gain-mpu:
    type: int
    default: 5000
    description: >
      Additional mechanical validation residual limit as a milli-per-unit
      multiplier of the aggregate in-fit RMS. The effective validation limit is
      max(commission-auto-mech-validate-rms-unm, gain * aggregate RMS).

  commission-auto-mech-min-confidence-mpu:
    type: int
    default: 500
    description: >
      Minimum aggregate mechanical-fit confidence in milli-per-unit. This is
      used as the fallback acceptance gate if the independent validation
      capture does not contain enough usable motion samples.

  commission-auto-normal-flux-min-mhz:
    type: int
    default: 500
    description: Normal auto-commission flux sweep minimum mechanical speed in mHz.

  commission-auto-normal-flux-max-mhz:
    type: int
    default: 3000
    description: Normal auto-commission flux sweep maximum mechanical speed in mHz.

  commission-auto-normal-mech-max-mhz:
    type: int
    default: 3000
    description: Normal auto-commission mechanical excitation maximum speed in mHz.

  commission-auto-normal-mech-base-mhz:
    type: int
    default: 1500
    description: Normal auto-commission mechanical excitation base speed in mHz.

  commission-auto-normal-mech-dither-mhz:
    type: int
    default: 500
    description: Normal auto-commission mechanical excitation dither speed in mHz.

  commission-auto-slow-flux-min-mhz:
    type: int
    default: 250
    description: Slow auto-commission flux sweep minimum mechanical speed in mHz.

  commission-auto-slow-flux-max-mhz:
    type: int
    default: 750
    description: Slow auto-commission flux sweep maximum mechanical speed in mHz.

  commission-auto-slow-mech-max-mhz:
    type: int
    default: 1000
    description: Slow auto-commission mechanical excitation maximum speed in mHz.

  commission-auto-slow-mech-base-mhz:
    type: int
    default: 500
    description: Slow auto-commission mechanical excitation base speed in mHz.

  commission-auto-slow-mech-dither-mhz:
    type: int
    default: 150
    description: Slow auto-commission mechanical excitation dither speed in mHz.
```

## dts/bindings/sensor/brcm,aeat-9955.yaml
```yaml
# Copyright (c) 2025 Rubus Technologies Inc.
# SPDX-License-Identifier: Apache-2.0

description: |
    Broadcom AEAT-9955 Magnetic Encoder

compatible: "brcm,aeat-9955"

include: [sensor-device.yaml, spi-device.yaml]

properties:
  zero-gpios:
    type: phandle-array
    description: |
      The ZERO signal is used to enable set the encoder zero position.

  error-gpios:
    type: phandle-array
    description: |
      The ERR signal is used to indicate an error condition.

  sleep-gpios:
    type: phandle-array
    description: |
      The SLEEP signal is used to put the device into low power mode.

  sensing-axis:
    type: string
    default: "on-axis"
    enum:
      - "on-axis"
      - "off-axis-radial"
      - "off-axis-axial"
      - "off-axis-side-shaft"
    description: |
      Sensing axis configuration.
```

## tests/unit/angle_observer/testcase.yaml
```yaml
tests:
  chopper.angle_observer.unit:
    tags:
      - chopper
      - motor
      - unit
      - observer
    harness: ztest
    integration_platforms:
      - native_sim
```

## tests/unit/control/testcase.yaml
```yaml
tests:
  chopper.control_ref_path.unit:
    tags:
      - chopper
      - motor
      - unit
      - control
      - arbitration
      - interlock
    harness: ztest
    integration_platforms:
      - native_sim
```

## tests/unit/encoder_decode/testcase.yaml
```yaml
tests:
  chopper.encoder_decode.unit:
    tags:
      - chopper
      - encoder
      - unit
      - decode
    harness: ztest
    integration_platforms:
      - native_sim
```

## tests/unit/motion_profile/testcase.yaml
```yaml
tests:
  chopper.motion_profile.unit:
    tags:
      - chopper
      - motor
      - unit
      - motion
    harness: ztest
    integration_platforms:
      - native_sim
```

## tests/unit/motor_align/testcase.yaml
```yaml
tests:
  chopper.motor_align.unit:
    tags:
      - chopper
      - motor
      - unit
      - align
      - calibration
    harness: ztest
    integration_platforms:
      - native_sim
```
