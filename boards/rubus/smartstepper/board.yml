## boards/rubus/smartstepper/board.yml
```yaml
# Copyright (c) 2025 Rubus Technologies Inc.
# SPDX-License-Identifier: Apache-2.0

board:
  name: smartstepper
  full_name: Smart Stepper
  vendor: rubus
  socs:
    - name: stm32f407xx
```

## drivers/Kconfig
```kconfig
# Copyright (c) 2021 Nordic Semiconductor ASA
# SPDX-License-Identifier: Apache-2.0

menu "Drivers"
rsource "adc/Kconfig"
rsource "rt_spi/Kconfig"
rsource "gate_driver/Kconfig"
rsource "pwm/Kconfig"
rsource "sensor/Kconfig"
rsource "timer_ic/Kconfig"
endmenu
```

## drivers/encoder/Kconfig
```kconfig
# Copyright (c) 2026 Rubus Technologies Inc
# SPDX-License-Identifier: Apache-2.0

menuconfig ENCODER_RT
	bool "Real-time encoder drivers"
	depends on RT_SPI
	default y if DT_HAS_BRCM_AEAT_9955_FAST_ENABLED
	default y if DT_HAS_MAGNTEK_MT6835_FAST_ENABLED
	help
	  Enables deterministic request/collect encoder drivers for high-rate
	  motor-control ISR use.

if ENCODER_RT

config ENCODER_RT_INIT_PRIORITY
	int "Real-time encoder init priority"
	default 86
	help
	  Device init priority. Keep this after RT_SPI_INIT_PRIORITY so child
	  encoder devices initialize after their low-latency transport.

config BRCM_AEAT_9955_FAST
	bool "AEAT-9955 real-time encoder driver"
	depends on DT_HAS_BRCM_AEAT_9955_FAST_ENABLED
	default y
	help
	  Enable the AEAT-9955 encoder driver that uses the low-latency rt_spi
	  transport and exposes the encoder_rt API.

config MAGNTEK_MT6835_FAST
	bool "MT6835 real-time encoder driver"
	depends on DT_HAS_MAGNTEK_MT6835_FAST_ENABLED
	select CRC
	default y
	help
	  Enable the MT6835 encoder driver that uses the low-latency rt_spi
	  transport and exposes the encoder_rt API.

endif # ENCODER_RT
```

## drivers/rt_spi/Kconfig
```kconfig
# Copyright (c) 2026 Rubus Technologies Inc
# SPDX-License-Identifier: Apache-2.0

menuconfig RT_SPI
	bool "Real-time SPI transport"
	depends on DT_HAS_RUBUS_STM32_RT_SPI_ENABLED
	default y
	select PINCTRL
	help
	  Enables the custom low-latency SPI transport used for deterministic
	  high-rate SPI transfers from ISR context with static buffers and a
	  single in-flight transaction.

if RT_SPI

config RT_SPI_MAX_FRAME_BYTES
	int "Maximum real-time SPI transfer length"
	default 8
	range 1 32
	help
	  Maximum transfer length copied by the transport. Runtime requests can
	  use shorter transfers up to this configured limit and the instance
	  max-frame-len devicetree property.

config RT_SPI_INIT_PRIORITY
	int "Real-time SPI init priority"
	default 85
	help
	  Device init priority. Keep this after the normal STM32 SPI driver so
	  legacy sensor shell paths initialize first, then the fast path installs
	  its deterministic configuration.

config RT_SPI_STM32_H7_FIFO
	bool "STM32H7 FIFO backend"
	default y if SOC_SERIES_STM32H7X
	depends on SOC_SERIES_STM32H7X
	help
	  Use the STM32H7 SPI FIFO interrupt backend.

endif # RT_SPI
```

## dts/bindings/encoder/brcm,aeat-9955-fast.yaml
```yaml
# Copyright (c) 2026 Rubus Technologies Inc
# SPDX-License-Identifier: Apache-2.0

description: AEAT-9955 encoder using a parent low-latency SPI transport

compatible: "brcm,aeat-9955-fast"

include: base.yaml

on-bus: rt-spi

properties:
  reg:
    required: true

  pipeline-delay-samples:
    type: int
    default: 1
    description: Protocol/sample delay to account for in angle-observer configuration.

  spi4-mode:
    type: string
    default: "spi4-16-parity"
    enum:
      - "spi4-16-parity"
      - "spi4-8-crc16"
    description: |
      Desired runtime protocol. The driver detects the current volatile AEAT
      protocol during init and switches the device to this mode before normal
      sampling starts. The EEPROM is not programmed.
```

## dts/bindings/encoder/magntek,mt6835-fast.yaml
```yaml
# Copyright (c) 2026 Rubus Technologies Inc
# SPDX-License-Identifier: Apache-2.0

description: MT6835 encoder using a parent low-latency SPI transport

compatible: "magntek,mt6835-fast"

include: base.yaml

on-bus: rt-spi

properties:
  reg:
    required: true

  pipeline-delay-samples:
    type: int
    default: 0
    description: Protocol/sample delay to account for in angle-observer configuration.

  cal-en-gpios:
    type: phandle-array
    description: Optional MT6835 calibration-enable GPIO.
```

## dts/bindings/input_capture/st,stm32-timer-ic.yaml
```yaml
# Copyright (c) 2023 Rubus Technologies Inc.
# SPDX-License-Identifier: Apache-2.0

description: |
  STM32 timer input capture.

  The input capture device is expected to be a child of a STM32 timer.

  Example usage:

      &timers1 {
          ic: ic {
              compatible = "st,stm32-timer-ic";
              pinctrl-0 = <&tim1_ch1_pa8>;
              pinctrl-names = "default";
              ...
          };
      };

compatible: "st,stm32-timer-ic"

include: [base.yaml, pinctrl-device.yaml]

properties:
  pinctrl-0:
    required: true

  pinctrl-names:
    required: true

  capture-gpios:
    type: phandle-array
    description: >
      Optional GPIOs corresponding to timer input-capture channels. When a
      channel is configured for both-edge capture, the STM32 timer does not
      expose which edge latched the CCR value. If provided, the driver samples
      the logical input level in the capture ISR and reports rising/falling
      status flags to the callback.
```

## dts/bindings/rt_spi/rubus,stm32-rt-spi.yaml
```yaml
# Copyright (c) 2026 Rubus Technologies Inc
# SPDX-License-Identifier: Apache-2.0

description: STM32 low-latency ISR-safe SPI transport

compatible: "rubus,stm32-rt-spi"

include:
  - base.yaml
  - pinctrl-device.yaml

properties:
  reg:
    required: true

  clocks:
    required: true

  interrupts:
    required: true

  "#address-cells":
    type: int
    const: 1

  "#size-cells":
    type: int
    const: 0

  st,spi-data-width:
    type: string
    required: true
    enum:
      - "full-4-to-32-bit"
      - "full-4-to-16-bit"
      - "limited-8-16-bit"
    description: STM32 SPI data-width capability inherited from the SoC node.

  fifo-size:
    type: int
    description: STM32H7 FIFO size in bytes inherited from the SoC node.

  fifo-max-transfer-size:
    type: int
    description: STM32H7 maximum FIFO-backed transfer size inherited from the SoC node.

  ioswp:
    type: boolean
    description: Swap SPI MOSI and MISO pins.

  spi-clock-frequency:
    type: int
    required: true
    description: Static SPI clock rate in Hz for this real-time transport instance.

  max-frame-len:
    type: int
    required: true
    description: Maximum transfer length in bytes accepted by this instance.

  cs-mode:
    type: string
    default: "hardware"
    enum:
      - "hardware"
      - "gpio"
      - "software"
    description: |
      Chip-select handling mode. "hardware" uses STM32 hardware NSS output,
      "gpio" drives cs-gpios around each transfer, and "software" leaves NSS
      internal/inactive for boards that gate CS externally.

  cs-gpios:
    type: phandle-array
    description: GPIO chip select used when cs-mode is "gpio".

  spi-cpol:
    type: boolean
    description: Use CPOL=1. Default is CPOL=0.

  spi-cpha:
    type: boolean
    description: Use CPHA=1. Default is CPHA=0.

  fifo-enable:
    type: boolean
    description: Enable STM32H7 FIFO servicing for this transport.

  mssi-clock:
    type: int
    default: 0
    description: STM32H7 master SS idleness setting.

  midi-clock:
    type: int
    default: 0
    description: STM32H7 master inter-data idleness setting.
```

## dts/bindings/rubus,motor-parameters.yaml
```yaml
# Copyright (c) 2024 Rubus Inc.
# SPDX-License-Identifier: Apache-2.0

description: >
  Motor identity, hard limits, and conservative boot fallback model.

  Values in this node must be safe enough for initial current control and
  commissioning after erased settings. They are not necessarily the active
  commissioned model once runtime identification or Settings/ZMS values are
  applied.

compatible: "rubus,motor-parameters"

properties:
  inductance-d-uh:
    type: int
    required: true
    description: Boot/fallback D-axis inductance in microhenries

  inductance-q-uh:
    type: int
    required: true
    description: Boot/fallback Q-axis inductance in microhenries

  resistance-mohms:
    type: int
    required: true
    description: Boot/fallback phase resistance in milliohms

  flux_linkage_uvphz:
    type: int
    description: >
      Optional boot/fallback permanent magnet flux linkage in microvolt-seconds
      per Hz. Omit when no reliable datasheet/profile value exists. A missing
      value is treated as unknown; commissioning should estimate and stage the
      runtime value before BEMF limits, torque-domain tuning, MPR, DOB, or
      mechanical ID are trusted.

  pole-pairs:
    type: int
    required: true
    description: Number of motor pole pairs

  max-current-ma:
    type: int
    required: true
    description: Maximum phase current in milliamps

  inertia-mgcm2:
    type: int
    required: true
    description: >
      Boot/fallback rotor/load inertia in milligram-cm². Commissioning should
      estimate and stage the runtime value before velocity/position tuning is
      trusted.

  max-speed-hz:
    type: int
    required: true
    description: Maximum mechanical speed in Hz
```
