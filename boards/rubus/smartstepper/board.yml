## tests/unit/motor_autonomy/testcase.yaml
```yaml
tests:
  chopper.motor_autonomy.unit:
    tags:
      - chopper
      - motor
      - unit
    integration_platforms:
      - native_sim
    harness: ztest
```

## tests/unit/motor_calibration_flow/testcase.yaml
```yaml
tests:
  chopper.motor_calibration_flow.unit:
    tags:
      - chopper
      - motor
      - unit
      - calibration
    harness: ztest
    integration_platforms:
      - native_sim
```

## tests/unit/motor_commission_estimators/testcase.yaml
```yaml
tests:
  chopper.motor_commission_estimators.unit:
    tags:
      - chopper
      - motor
      - unit
      - commissioning
      - identification
    harness: ztest
    integration_platforms:
      - native_sim
```

## tests/unit/motor_commission_tune/testcase.yaml
```yaml
tests:
  chopper.motor_commission_tune.unit:
    tags:
      - chopper
      - motor
      - unit
      - commission
      - tune
    integration_platforms:
      - native_sim
    harness: ztest
```

## tests/unit/motor_control_kernel/testcase.yaml
```yaml
tests:
  chopper.motor_control_kernel.unit:
    platform_allow: native_sim
    tags: motor control kernel
```

## tests/unit/motor_control_policy/testcase.yaml
```yaml
tests:
  chopper.motor_control_policy.unit:
    tags:
      - chopper
      - motor
      - unit
    integration_platforms:
      - native_sim
    harness: ztest
```

## tests/unit/motor_core_contracts/testcase.yaml
```yaml
tests:
  chopper.motor_core_contracts.unit:
    tags:
      - chopper
      - motor
      - unit
      - integration
      - contracts
    harness: ztest
    integration_platforms:
      - native_sim
```

## tests/unit/motor_current_ref_policy_core/testcase.yaml
```yaml
tests:
  chopper.motor_current_ref_policy_core.unit:
    tags:
      - chopper
      - motor
      - unit
      - current
      - policy
    harness: ztest
    integration_platforms:
      - native_sim
```

## tests/unit/motor_detent_map/testcase.yaml
```yaml
tests:
  chopper.motor_detent_map.unit:
    platform_allow: native_sim
    tags:
      - motor
      - unit
```
