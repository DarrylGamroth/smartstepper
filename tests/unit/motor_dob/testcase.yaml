## tests/unit/motor_dob/testcase.yaml
```yaml
tests:
  chopper.motor_dob.unit:
    tags:
      - chopper
      - motor
      - unit
      - dob
    harness: ztest
    integration_platforms:
      - native_sim
```

## tests/unit/motor_electrical_id/testcase.yaml
```yaml
tests:
  chopper.motor_electrical_id.unit:
    tags:
      - chopper
      - motor
      - unit
      - estimation
      - electrical_id
    harness: ztest
    integration_platforms:
      - native_sim
```

## tests/unit/motor_electrical_ripple_ff/testcase.yaml
```yaml
tests:
  chopper.motor_electrical_ripple_ff.unit:
    platform_allow: native_sim
    tags:
      - motor
      - unit
```

## tests/unit/motor_encoder_feedback_core/testcase.yaml
```yaml
tests:
  chopper.motor_encoder_feedback_core.unit:
    tags:
      - chopper
      - motor
      - unit
      - encoder
      - feedback
    harness: ztest
    integration_platforms:
      - native_sim
```

## tests/unit/motor_encoder_map_detect/testcase.yaml
```yaml
tests:
  chopper.motor_encoder_map_detect.unit:
    tags:
      - chopper
      - motor
      - unit
      - encoder
      - calibration
    harness: ztest
    integration_platforms:
      - native_sim
```

## tests/unit/motor_foc_voltage_pwm/testcase.yaml
```yaml
tests:
  chopper.motor_foc_voltage_pwm.unit:
    tags:
      - chopper
      - motor
      - unit
      - foc
      - pwm
    harness: ztest
    integration_platforms:
      - native_sim
```

## tests/unit/motor_identification/testcase.yaml
```yaml
tests:
  chopper.motor_identification.unit:
    tags:
      - chopper
      - motor
      - unit
      - commissioning
      - identification
    harness: ztest
    integration_platforms:
      - native_sim
```

## tests/unit/motor_keepalive_policy/testcase.yaml
```yaml
tests:
  chopper.motor_keepalive_policy.unit:
    tags:
      - chopper
      - motor
      - unit
    integration_platforms:
      - native_sim
    harness: ztest
```

## tests/unit/motor_motion_modules/testcase.yaml
```yaml
tests:
  chopper.motor_motion_modules.unit:
    tags:
      - chopper
      - motor
      - unit
      - motion
    harness: ztest
    integration_platforms:
      - native_sim
```

## tests/unit/motor_mpr/testcase.yaml
```yaml
tests:
  chopper.motor_mpr.unit:
    tags:
      - chopper
      - motor
      - unit
      - control
      - mpr
    harness: ztest
    integration_platforms:
      - native_sim
```

## tests/unit/motor_outer_loop_sched/testcase.yaml
```yaml
tests:
  chopper.motor_outer_loop_sched.unit:
    tags:
      - chopper
      - motor
      - unit
      - scheduler
    harness: ztest
    integration_platforms:
      - native_sim
```

## tests/unit/motor_persistent_config/testcase.yaml
```yaml
tests:
  chopper.motor_persistent_config.unit:
    platform_allow: native_sim
    tags: motor persistence
```

## tests/unit/motor_position_convert/testcase.yaml
```yaml
tests:
  chopper.motor_position_convert.unit:
    tags:
      - chopper
      - motor
      - unit
      - position
      - convert
    harness: ztest
    integration_platforms:
      - native_sim
```

## tests/unit/motor_rl_ident/testcase.yaml
```yaml
tests:
  chopper.motor_rl_ident.unit:
    tags:
      - chopper
      - motor
      - unit
      - calibration
      - commissioning
    harness: ztest
    integration_platforms:
      - native_sim
```

## tests/unit/motor_saliency_id/testcase.yaml
```yaml
tests:
  chopper.motor_saliency_id.unit:
    tags:
      - chopper
      - motor
      - unit
      - estimation
      - saliency_id
    harness: ztest
    integration_platforms:
      - native_sim
```

## tests/unit/pi_controller/testcase.yaml
```yaml
tests:
  chopper.pi_controller.unit:
    tags:
      - chopper
      - motor
      - unit
      - pi
      - controller
    harness: ztest
    integration_platforms:
      - native_sim
```

## tests/unit/pi_filter/testcase.yaml
```yaml
tests:
  chopper.pi_filter.unit:
    tags:
      - chopper
      - motor
      - unit
      - pi
      - filter
    harness: ztest
    integration_platforms:
      - native_sim
```

## tests/unit/prbs/testcase.yaml
```yaml
tests:
  chopper.prbs.unit:
    tags:
      - chopper
      - motor
      - unit
      - prbs
    harness: ztest
    integration_platforms:
      - native_sim
```

## tests/unit/rls_motor_est/testcase.yaml
```yaml
tests:
  chopper.rls_motor_est.unit:
    tags:
      - chopper
      - motor
      - unit
      - rls
    harness: ztest
    integration_platforms:
      - native_sim
```

## tests/unit/rs_online/testcase.yaml
```yaml
tests:
  chopper.rs_online.unit:
    tags:
      - chopper
      - motor
      - unit
      - rs
    harness: ztest
    integration_platforms:
      - native_sim
```

## tests/unit/runtime/testcase.yaml
```yaml
tests:
  chopper.runtime.unit:
    tags:
      - chopper
      - motor
      - unit
      - runtime
    harness: ztest
    integration_platforms:
      - native_sim
```

## tests/unit/thermal_model/testcase.yaml
```yaml
tests:
  chopper.thermal_model.unit:
    tags:
      - chopper
      - motor
      - unit
      - thermal
    harness: ztest
    integration_platforms:
      - native_sim
```

## tests/unit/traj/testcase.yaml
```yaml
tests:
  chopper.traj.unit:
    tags:
      - chopper
      - motor
      - unit
      - traj
    harness: ztest
    integration_platforms:
      - native_sim
```
